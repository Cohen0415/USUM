## u-boot/drivers/usum/Kconfig
```kconfig
menuconfig USUM
    bool "uSum"
    default n
    help
      Enable uSum: the U-Boot System Update Manager.
      When enabled, allows selecting update sources (USB, SD, TFTP) and
      choosing system components (kernel, DTB, rootfs) to update via menu.

      启用 uSum：U-Boot 系统更新管理器。
      启用后可通过菜单选择更新源（USB、SD 卡、TFTP）以及需要更新的内容（如内核、设备树、rootfs 等）。

if USUM

config USUM_LOG_ENABLE
    bool
    default y

config USUM_LOG_LEVEL
    int "Default log level (0:INFO, 1:WARN, 2:ERROR, 3:DEBUG)"
    depends on USUM_LOG_ENABLE
    range 0 3
    default 0
    help
      Select the minimum log level USUM will output.
      仅打印级别小于等于该值的日志（0=仅 INFO，3=全部）。

endif # USUM
```
